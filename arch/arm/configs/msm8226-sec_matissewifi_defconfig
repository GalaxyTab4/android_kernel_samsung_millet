## arch/arm/configs/msm8226-sec_matissewifi_defconfig
```kconfig
# SSWAP
CONFIG_SWAP=y
CONFIG_FRONTSWAP=y
CONFIG_ZSMALLOC_NEW=y
CONFIG_PGTABLE_MAPPING=y
CONFIG_ZSWAP=y
CONFIG_DIRECT_RECLAIM_FILE_PAGES_ONLY=n
CONFIG_INCREASE_MAXIMUM_SWAPPINESS=y
CONFIG_FIX_INACTIVE_RATIO=y
CONFIG_TIGHT_PGDAT_BALANCE=y
CONFIG_VNSWAP=y
CONFIG_SWAP_ENABLE_READAHEAD=n

#variant defconfig
CONFIG_MACH_MATISSEWIFI_OPEN=y
CONFIG_SEC_MATISSE_PROJECT=y
CONFIG_SEC_MATISSEWIFI_COMMON=y

#Power Management
CONFIG_SEC_PM=n

#LCD
CONFIG_FB_MSM_MDSS_TC_DSI2LVDS_WXGA_PANEL=y
CONFIG_FB_MSM8x26_MDSS_CHECK_LCD_CONNECTION=y
#CONFIG_ESD_ERR_FG_RECOVERY=y
CONFIG_FB_MSM_MDSS=y
CONFIG_FB_MSM_MDSS_WRITEBACK=y
CONFIG_BACKLIGHT_LCD_SUPPORT=y
CONFIG_MDNIE_TFT_MSM8X26=y
CONFIG_LCD_CLASS_DEVICE=y
CONFIG_BACKLIGHT_CLASS_DEVICE=y
# CONFIG_BACKLIGHT_GENERIC is not set
#CONFIG_TC358764_I2C_CONTROL=y

#SvcLED
CONFIG_LEDS_GPIO=y

#TSP
CONFIG_TOUCHSCREEN_ATMEL_MXT1188S=y

#SENSOR
CONFIG_SENSORS=y
CONFIG_SENSORS_K2HH=y
#CONFIG_NFC_PN547=y
#CONFIG_NFC_PN547_CLOCK_REQUEST=y

CONFIG_INPUT=y
CONFIG_INPUT_GPIO=y
CONFIG_SENSORS_HALL=y

#CAMERA
CONFIG_MSM_CPP=y
#CONFIG_S5K3H5XA=y
#CONFIG_S5K4H5YB=y
#CONFIG_S5K6A3YX=y
#CONFIG_ISX012=y
CONFIG_SR352=y
CONFIG_SR130PC20=y

#USB
CONFIG_USB_ANDROID_SAMSUNG_COMPOSITE=y
#CONFIG_USB_ANDROID_SAMSUNG_MTP is not set
CONFIG_USB_DUN_SUPPORT=y
CONFIG_USB_ANDROID_SAMSUNG_SIDESYNC=y

#USB Host
CONFIG_USB_HOST_NOTIFY=y
CONFIG_USB_STORAGE_DETECT=y
CONFIG_USB_NET_SMSC75XX=y
CONFIG_USB_NET_SMSC95XX=y

#MUIC
#CONFIG_MFD_MAX77693=y
#CONFIG_USB_SWITCH_MAX77693=y
#CONFIG_REGULATOR_MAX77693=y
#CONFIG_DI_MUIC=n
#CONFIG_MUIC_INIT_DETECT_DELAY=3000
#CONFIG_MUIC_USB_DETECT_DELAY=17000
#CONFIG_USB_SWITCH_TSU6721=y
CONFIG_SM5502_MUIC=y

# IRDA support
# CONFIG_IR_REMOCON_MC96FR116=y

#Battery charging & BMS
CONFIG_BATTERY_SAMSUNG=y
CONFIG_CHARGER_SMB358=y
CONFIG_BATTERY_BCL=y
CONFIG_QPNP_BMS=y
CONFIG_SAMSUNG_LPM_MODE=y

# TIMA LOG
CONFIG_ARCH_MSM8226_3G_WIFI=y
CONFIG_MUIC_SM5502_SUPPORT_LANHUB_TA=y

#Sec Thermistor
CONFIG_SEC_THERMISTOR=y

# Earjack
CONFIG_SAMSUNG_JACK=y
```
